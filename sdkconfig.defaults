## sdkconfig.defaults
```kconfig
# Arduino 作为 ESP-IDF 组件运行
CONFIG_AUTOSTART_ARDUINO=y
CONFIG_FREERTOS_HZ=1000
# 4MB flash + 自定义分区(huge_app.csv: 3MB app + ~960KB SPIFFS 存图片)
CONFIG_ESPTOOLPY_FLASHSIZE_4MB=y
CONFIG_PARTITION_TABLE_CUSTOM=y
CONFIG_PARTITION_TABLE_CUSTOM_FILENAME="huge_app.csv"
# arduino ssl_client 依赖的 PSK 配置(避免编译警告/缺符号)
CONFIG_MBEDTLS_KEY_EXCHANGE_PSK=y
CONFIG_MBEDTLS_PSK_MODES=y
# 图片/绘画引擎运行在 Arduino loop 任务,解码缓冲需要较大栈
CONFIG_ARDUINO_LOOP_STACK_SIZE=16384
```
